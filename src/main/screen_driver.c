// Low-level screen driver module
//-----------------------------------

#include <stdlib.h>
#include <string.h>
#include "driver/i2c.h"

#include "screen_driver.h"

//ADC logo - TEST CODE
static uint8_t buffer[SH1106_LCDHEIGHT * SH1106_LCDWIDTH / 8] = { 0x0,  0x0,  0x0,  0x0,  0x0,  0x0,  0x0,  0x0,  0x0,  0x0,  0x0,  0x0,  0x0,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  0x0,  0x0};

static const uint8_t oled_font6x8[] = {
    0x00, 0x00, 0x00, 0x00, 0x00, 0x00, // sp
    0x00, 0x00, 0x00, 0x2f, 0x00, 0x00, // !
    0x00, 0x00, 0x07, 0x00, 0x07, 0x00, // "
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    0x00, 0x7E, 0x01, 0x49, 0x55, 0x73, // ß
};


static esp_err_t i2c_init(void)
{
    int i2c_master_port = I2C_NUM;
    i2c_config_t conf;
    conf.mode = I2C_MODE_MASTER;
    conf.sda_io_num = PIN_I2C_SDA;
    conf.sda_pullup_en = GPIO_PULLUP_ENABLE;
    conf.scl_io_num = PIN_I2C_SCL;
    conf.scl_pullup_en = GPIO_PULLUP_ENABLE;
    conf.master.clk_speed = I2C_FREQ;
    i2c_param_config(i2c_master_port, &conf);
    return i2c_driver_install(i2c_master_port, conf.mode, I2C_RX_BUFFER, I2C_TX_BUFFER, 0);
}

static void display_command(uint8_t c) 
{
    i2c_cmd_handle_t cmd = i2c_cmd_link_create();
    i2c_master_start(cmd);
    i2c_master_write_byte(cmd, I2C_DISPLAY_ADDRESS << 1 | I2C_WRITE_BIT, I2C_ACK_CHECK_EN); 
    i2c_master_write_byte(cmd, 0x00, I2C_ACK_CHECK_EN);
    i2c_master_write_byte(cmd, c, I2C_ACK_CHECK_EN);
    i2c_master_stop(cmd);
    i2c_master_cmd_begin(I2C_NUM, cmd, 1000 / portTICK_RATE_MS);
    i2c_cmd_link_delete(cmd);
}

void refresh_display(void)
{
    display_command(SH1106_SETLOWCOLUMN | 0x0);  // low col = 0
    display_command(SH1106_SETHIGHCOLUMN | 0x0);  // hi col = 0
    display_command(SH1106_SETSTARTLINE | 0x0); // line #0

    int height= 64;
	int width=132; //2 pixel overrun to either side 
	int m_row = 0;
	int m_col = 2;
	
	height >>= 3;
	width >>= 3;
	
	int p = 0;
	
	int i, j, k =0;
	

	for ( i = 0; i < height; i++) {
		
		// send a bunch of data in one xmission
        display_command(0xB0 + i + m_row);//set page address
        display_command(m_col & 0xf);//set lower column address
        display_command(0x10 | (m_col >> 4));//set higher column address
		
        for( j = 0; j < 8; j++){        
			i2c_cmd_handle_t cmd = i2c_cmd_link_create();
            i2c_master_start(cmd);
            i2c_master_write_byte(cmd, I2C_DISPLAY_ADDRESS << 1 | I2C_WRITE_BIT, I2C_ACK_CHECK_EN); 
            i2c_master_write_byte(cmd, 0x40, I2C_ACK_CHECK_EN);
            for ( k = 0; k < width; k++, p++) {
		        i2c_master_write_byte(cmd, buffer[p], I2C_ACK_CHECK_EN);
            }
            i2c_master_stop(cmd);
            i2c_master_cmd_begin(I2C_NUM, cmd, 1000 / portTICK_RATE_MS);
            i2c_cmd_link_delete(cmd);
        }
	}
}

void enable_display(void)
{
    ESP_ERROR_CHECK(i2c_init());
    
    //TODO: document this set of magic and tidy up 

    display_command(0xAE);

    display_command(0xD5);
    display_command(0x80);

    display_command(0xA8);
    display_command(0x3F);

    display_command(0xD3);
    display_command(0x00);

    display_command(0x40);

    display_command(0x8D);
    display_command(0x10);

    display_command(0xA4);
    display_command(0xAF);

    refresh_display();
}

void disable_display(void)
{
    display_command(0xAE);
}

void clear_display(void)
{
    memset(buffer, 0, (SH1106_LCDWIDTH*SH1106_LCDHEIGHT/8));
}

void draw_pixel(int16_t x, int16_t y, uint16_t type)
{
    if ((x < 0) || (x >= SH1106_LCDWIDTH ) || (y < 0) || (y >= SH1106_LCDHEIGHT)) { return; }
    switch (type) 
    {
      case WHITE:   
        buffer[x+ (y/8)*SH1106_LCDWIDTH] |=  (1 << (y&7)); 
        break;
      case BLACK:   
        buffer[x+ (y/8)*SH1106_LCDWIDTH] &= ~(1 << (y&7)); 
        break; 
      case INVERT:  
        buffer[x+ (y/8)*SH1106_LCDWIDTH] ^=  (1 << (y&7)); 
        break; 
    }

}

void draw_line(int16_t x1, int16_t y1, int16_t x2, int16_t y2, uint16_t type)
{  
    int16_t dx, dy, sx, sy, err, e2;

    dx = abs(x2-x1);
    if (x1<x2) { sx = 1; } else { sx = -1; }
    dy = -abs(y2-y1);
    if (y1<y2) { sy = 1; } else { sy = -1; }
    err = dx+dy;  /* error value e_xy */
    while (true)
    {
        if (x1==x2 && y1==y2) { break; }
        e2 = 2*err;
        if (e2 >= dy)
        { 
            err += dy;
            x1 += sx;
        }
        if (e2 <= dx)
        {
            err += dx;
            y1 += sy;
        }
        draw_pixel(x1,y1,type);
    }
}

void draw_rect(int16_t x1, int16_t y1, int16_t x2, int16_t y2, uint16_t outline, uint16_t fill)
{
    int16_t sx, sy, x, y;

    if (x1<x2) { sx = 1; } else { sx = -1; }
    if (y1<y2) { sy = 1; } else { sy = -1; }
    
    draw_line(x1,y1,x1,y2,outline);
    draw_line(x1,y1,x2,y1,outline);
    draw_line(x2,y2,x1,y2,outline);
    draw_line(x2,y2,x2,y1,outline);

    if (fill != LEAVE)
    {
        for ( x = x1 + sx; x != x2; x=x+sx) 
        {
            for ( y = y1 + sy; y != y2; y=y+sy) 
            {
                draw_pixel(x,y,fill);
            }
        }
    }

}

void draw_circle(int16_t xc, int16_t yc, int16_t r, uint16_t outline, uint16_t fill)
{
    return; 
}

void static draw_byte(uint_fast8_t x, uint_fast8_t y, uint8_t b, uint8_t type)
{
    if ((x < 0) || (x >= SH1106_LCDWIDTH ) || (y < 0) || (y >= SH1106_LCDHEIGHT)) { return; }

    uint_fast16_t buffer_index = y / 8 * SH1106_LCDWIDTH + x;

    //TODO - handle different draw types - assumes white only for now
        
    // If the y position matches a page, then easy mode:
    if (y % 8 == 0)
    {
        if (buffer_index < (SH1106_LCDHEIGHT * SH1106_LCDWIDTH / 8))
        {
            buffer[buffer_index] |= b;
        }
    }
    else
    {
        uint16_t w = (uint16_t) b << (y % 8);
        if (buffer_index < (SH1106_LCDHEIGHT * SH1106_LCDWIDTH / 8))
        {
            buffer[buffer_index] |= (w & 0xFF);
        }
        uint16_t buffer_index2 = buffer_index + SH1106_LCDWIDTH;
        if (buffer_index2 < (SH1106_LCDHEIGHT * SH1106_LCDWIDTH / 8))
        {
            buffer[buffer_index2] |= (w >> 8);
        }
    }
    
}

void static draw_bytes(uint_fast8_t x, uint_fast8_t y, const uint8_t* data, uint_fast8_t size, uint_fast8_t scaling, uint_fast8_t type)
{
    for (uint_fast8_t column = 0; column < size; column++)
    {
        uint8_t b;
        
        b = *data;
        
        data++;
        if (scaling == DOUBLE_SIZE)
        {
            // Stretch vertically
            uint16_t w = 0;
            for (uint_fast8_t bit = 0; bit < 7; bit++)
            {
                if (b & (1 << bit))
                {
                    uint_fast8_t pos = bit << 1;
                    w |= ((1 << pos) | (1 << (pos + 1)));
                }
            }

            // Output 2 times to strech hozizontally            
            draw_byte(x, y, w & 0xFF, type);
            draw_byte(x, y + 8, (w >> 8), type);
            x++;
            draw_byte(x, y, w & 0xFF, type);
            draw_byte(x, y + 8, (w >> 8), type);
            x++;
        }
        else // NORMAL_SIZE
        {
            draw_byte(x++, y, b, type);
        }
    }
}

void static draw_character(uint_fast8_t x, uint_fast8_t y, char c, uint_fast8_t scaling, uint_fast8_t type)
{
    // Invalid position
    if (x >= SH1106_LCDWIDTH || y >= SH1106_LCDHEIGHT || c < 32)
    {
        return;
    }
    uint16_t font_index = (c - 32)*6;

    // Invalid character code/font index
    if (font_index >= sizeof (oled_font6x8))
    {
        return 0;
    }

    draw_bytes(x, y, &oled_font6x8[font_index], 6, scaling, type);
}

void draw_string(uint_fast8_t x, uint_fast8_t y, const char* s, uint_fast8_t scaling, uint_fast8_t type)
{
    while (*s)
    {
        draw_character(x, y, *s, scaling, type);
        if (scaling == DOUBLE_SIZE)
        {
            x += 12;
        }
        else // NORMAL_SIZE
        {
            x += 6;
        }
        s++;
    }
}
